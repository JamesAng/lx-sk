/dts-v1/;

/ {
	model = "TI OMAP4 PandaBoard";
	compatible = "ti,omap4-panda";
	#address-cells = <1>;
	#size-cells = <1>;

	chosen {
	};

	aliases {
	};

	memory {
		device_type = "memory";
		reg = <0x80000000 0x40000000>;
	};
};
