/*
 * Copyright 2011 Linaro Ltd.
 *
 * The code contained herein is licensed under the GNU General Public
 * License. You may obtain a copy of the GNU General Public License
 * Version 2 or later at the following locations:
 *
 * http://www.opensource.org/licenses/gpl-license.html
 * http://www.gnu.org/copyleft/gpl.html
 */

/dts-v1/;

/ {
	model = "Genesi EfikaMX nettop";
	compatible = "genesi,efikamx";
	#address-cells = <1>;
	#size-cells = <1>;

	aliases {
	};

	memory {
		device_type = "memory";
		reg = <0x90000000 0x20000000>;
	};

	chosen {
	};
};
