## Documentation/devicetree/bindings/arm/samsung/smdkv310.txt
```
* Samsung's Exynos4 S5PV310 SoC based SMDKV310 eval board *

SMDKV310 eval board is based on S5PV310 SoC which belongs to Samsung's Exynos4
family of application processors.

* Root node

  The root node describes the smdkv310 eval board.

  Required Properties:

    - compatible : It should be one or more of the following.
        (a) "samsung,smdkv310" - for Samsung's SMDKV310 eval board.
        (b) "samsung,s5pv310"  - for boards based on S5PV310 SoC.
```
